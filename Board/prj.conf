## CMakeLists.txt
```
cmake_minimum_required(VERSION 3.20.0)

list(APPEND ZEPHYR_EXTRA_MODULES
    /Users/artaosmani/sdk-edge-ai/edge-ai
)

find_package(Zephyr REQUIRED HINTS $ENV{ZEPHYR_BASE})
project(polyp_classifier)

include(${ZEPHYR_BASE}/samples/subsys/usb/common/common.cmake)

target_sources(app PRIVATE
    src/main.c
    src/tjpgd.c
)

target_include_directories(app PRIVATE
    src
)
```

## Kconfig
```
# VID/PID/strings for sample_usbd_init_device() (Zephyr's USB sample helper)
source "samples/subsys/usb/common/Kconfig.sample_usbd"

source "Kconfig.zephyr"
```

## prj.conf
```kconfig
# USB device stack "next" with one CDC-ACM UART on the high-speed controller (J3)
CONFIG_USB_DEVICE_STACK_NEXT=y
CONFIG_USBD_CDC_ACM_CLASS=y
CONFIG_SERIAL=y
CONFIG_UART_LINE_CTRL=y
CONFIG_UART_INTERRUPT_DRIVEN=y

CONFIG_FPU=y
CONFIG_CBPRINTF_FP_SUPPORT=y
CONFIG_MAIN_STACK_SIZE=8192
CONFIG_LOG=y
# logs go to the UART console on the DK's debugger port, never to the CDC-ACM data port

#axon
CONFIG_NRF_AXON=y
CONFIG_NRF_AXON_INTERLAYER_BUFFER_SIZE=128000
# logs go to the UART console on the DK's debugger port, never to the CDC-ACM data


# the CDC-ACM class logs every FIFO call / packet at INF; keep only warnings
CONFIG_USBD_CDC_ACM_LOG_LEVEL_WRN=y
# CPU busy share during the frame receive (rx_busy_pct in the reply)
CONFIG_THREAD_RUNTIME_STATS=y
CONFIG_SCHED_THREAD_USAGE=y
CONFIG_SCHED_THREAD_USAGE_ALL=y
```

## app.overlay
```dts
/* One CDC-ACM UART on the default USB device controller (zephyr_udc0 = the high-speed USB on J3). */
&zephyr_udc0 {
	cdc_acm_uart0: cdc_acm_uart0 {
		compatible = "zephyr,cdc-acm-uart";
	};
};


/* Axon NPU exists only on nRF54LM20B (disabled in the SoC dtsi). */
&axon {
	status = "okay";
};
```

## src/main.c
```c
/*
 * Polyp classifier on the nRF54LM20 DK: JPEG frame in over USB CDC-ACM (J3), MobileNetV1 0.25 INT8 on the Axon NPU,
 * one result line out per frame, plus the frame bytes when a polyp is detected.
 *
 * Protocol (PC -> board), one frame at a time:
 *   "FRM0" | u32 frame_id (LE) | u32 jpeg_len (LE) | jpeg bytes            (336x336 baseline JPEG, ~20-40 KB)
 *   "RAW0" | u32 frame_id (LE) | u32 len (LE)      | RGB888 pixels         (DEC_SIDE x DEC_SIDE, row-major HWC;
 *                                                                           84x84 = 21168 B: no decode on the board)
 * Reply (board -> PC):
 *   "R,<frame_id>,<t_first_us>,<t_rx_us>,<t_infer_start_us>,<t_infer_end_us>,<t_sent_us>,<raw>,<score>,<detected>,<n>,
 *    <rx_reads>,<rx_gap_max_us>,<rx_pauses>,<rx_busy_pct>\n"
 *   followed by n bytes (the same payload, JPEG or raw) when detected=1, else n=0.
 *   "FWD0" | u32 frame_id | u32 len | bytes: baseline "everything to the edge": no compute, the same R line with
 *                                            detected=1 and the payload forwarded as is.
 *   "DET0" | u32 frame_id | u32 len | RGB888 DET_INPUT_SIZE^2 (160x160 = 76800 B): YOLO26 box detector on Axon
 *     -> "D,<frame_id>,<t_first_us>,<t_rx_us>,<t_infer_start_us>,<t_infer_end_us>,<t_decode_end_us>,<t_sent_us>,
 *         <n_boxes>[,<x0>,<y0>,<x1>,<y1>,<conf>]...\n"   boxes in model-input pixels, conf >= DET_CONF_FLOOR,
 *         best first, at most DET_MAX (the PC applies the deployment confidence)
 *   "CMD0" | u32 frame_id | u32 len | command bytes (<= 64): injection command from the edge
 *     -> "A,<frame_id>,<t_first_us>,<t_rx_us>\n" as soon as the command is in (the actuation point)
 * Times are board uptime in microseconds (k_cycle_get_64): t_first = header received, t_rx = last frame byte
 * received, t_infer_start/end around the Axon call only, t_sent = just before the reply is written.
 * t_rx -> t_infer_start is the preprocessing (JPEG decode at reduced scale, resize, input LUT, HWC -> CHW; for
 * RAW0 only the LUT and HWC -> CHW).
 *
 * Model files (see ../README.md): src/generated/nrf_axon_model_polyp_.h from the Axon compiler, and
 * src/model_int8.h from Classifier/train.py (only its constants and polyp_input_lut are used).
 */
#include <assert.h>
#include <string.h>
#include <math.h>
#include <zephyr/kernel.h>
#include <zephyr/device.h>
#include <zephyr/drivers/uart.h>
#include <zephyr/sys/byteorder.h>
#include <zephyr/sys/ring_buffer.h>
#include <zephyr/logging/log.h>
#include <sample_usbd.h>

#include <axon/nrf_axon_platform.h>
#include "drivers/axon/nrf_axon_driver.h"
#include "drivers/axon/nrf_axon_nn_infer.h"
#include "generated/nrf_axon_model_polyp_.h"
#include "generated/nrf_axon_model_det_.h"
#include "model_int8.h"
#include "axon_int8.h"
#include "tjpgd.h"

LOG_MODULE_REGISTER(polyp, LOG_LEVEL_INF);

#define MODEL      model_polyp  /* model_<model_name> from axon/polyp_compile.yaml */
#define FRAME_SIDE 336
#define MAX_JPEG   (64 * 1024)
#define S          POLYP_INPUT_SIZE
/* 84 = 336/4: a 1/4-scale decode is the model input. 96: decode at 1/2 (168 px) and area-resize to 96. */
#define JPEG_SCALE ((S) == 84 ? 2 : 1)   /* tjpgd scale: 0 = 1/1, 1 = 1/2, 2 = 1/4, 3 = 1/8 */
#define DEC_SIDE   (FRAME_SIDE >> JPEG_SCALE)
#define DET_MODEL  model_det    /* axon/det_compile.yaml */
#define DET_BYTES  (DET_INPUT_SIZE * DET_INPUT_SIZE * 3)
#define DET_MAX    5
#define DET_CONF_FLOOR 0.10f
#define MAX_CMD    64

static const struct device *const cdc = DEVICE_DT_GET_ONE(zephyr_cdc_acm_uart);

RING_BUF_DECLARE(rx_ring, 16 * 1024);
RING_BUF_DECLARE(tx_ring, 16 * 1024);
static K_SEM_DEFINE(rx_sem, 0, 1);
static K_SEM_DEFINE(tx_sem, 0, 1);

static uint8_t jpeg[MAX(MAX_JPEG, DET_BYTES)];  /* JPEG, FWD0 or DET0 payload */
static uint8_t decoded[DEC_SIDE * DEC_SIDE * 3];   /* RGB888 at the decode scale */
static uint8_t tjpgd_pool[4096];
static int8_t input_chw[3 * S * S];               /* Axon wants channels outermost (TFLite is HWC) */
static int8_t output[16];
static int8_t det_chw[DET_BYTES];
static int8_t det_out[4096];                      /* packed head outputs, checked against the model in main() */

/* ------------------------------------------------------------------ USB CDC-ACM */

static inline uint64_t now_us(void)
{
	return k_cyc_to_us_floor64(k_cycle_get_64());
}

/* RX diagnostics for the frame being received: reset by main() after the header, reported in the reply */
static struct {
	uint32_t reads;      /* uart_fifo_read() calls that returned data */
	uint32_t pauses;     /* times RX was paused because rx_ring was full */
	uint32_t gap_max_us; /* longest time between two of those reads */
	uint64_t last_us;
} rxd;

static void uart_cb(const struct device *dev, void *user)
{
	uint8_t buf[512];

	while (uart_irq_update(dev) && uart_irq_is_pending(dev)) {
		if (uart_irq_rx_ready(dev)) {
			uint32_t room = MIN(ring_buf_space_get(&rx_ring), sizeof(buf));

			if (!room) {
				/* ring full: leave the bytes in the CDC FIFO (USB NAKs the host) until read_exact drains it */
				uart_irq_rx_disable(dev);
				rxd.pauses++;
			} else {
				int n = uart_fifo_read(dev, buf, room);

				if (n > 0) {
					uint64_t t = now_us();

					if (rxd.last_us) {
						rxd.gap_max_us = MAX(rxd.gap_max_us, (uint32_t)(t - rxd.last_us));
					}
					rxd.last_us = t;
					rxd.reads++;
					ring_buf_put(&rx_ring, buf, n);
					k_sem_give(&rx_sem);
				}
			}
		}
		if (uart_irq_tx_ready(dev)) {
			uint8_t *p;
			uint32_t n = ring_buf_get_claim(&tx_ring, &p, 512);

			if (!n) {
				uart_irq_tx_disable(dev);
			} else {
				int sent = uart_fifo_fill(dev, p, n); /* not inside MAX(): the macro would call it twice */

				ring_buf_get_finish(&tx_ring, MAX(sent, 0));
			}
			k_sem_give(&tx_sem);
		}
	}
}

static void read_exact(uint8_t *dst, size_t len)
{
	while (len) {
		uint32_t n = ring_buf_get(&rx_ring, dst, len);

		if (!n) {
			k_sem_take(&rx_sem, K_FOREVER);
			continue;
		}
		uart_irq_rx_enable(cdc); /* room again: resume if the callback paused RX */
		dst += n;
		len -= n;
	}
}

/* Queue bytes for the TX interrupt and return once all of them are handed to the USB stack. */
static void write_all(const uint8_t *src, size_t len)
{
	while (len) {
		uint32_t n = ring_buf_put(&tx_ring, src, len);

		src += n;
		len -= n;
		uart_irq_tx_enable(cdc);
		if (len || !ring_buf_is_empty(&tx_ring)) {
			k_sem_take(&tx_sem, K_MSEC(10));
		}
	}
	while (!ring_buf_is_empty(&tx_ring)) {
		k_sem_take(&tx_sem, K_MSEC(10));
	}
}

/* ------------------------------------------------------------------ JPEG -> model input */

struct src { const uint8_t *p; size_t left; };

static size_t jd_in(JDEC *jd, uint8_t *buf, size_t n)
{
	struct src *s = jd->device;

	n = MIN(n, s->left);
	if (buf) {
		memcpy(buf, s->p, n);
	}
	s->p += n;
	s->left -= n;
	return n;
}

static int jd_out(JDEC *jd, void *bitmap, JRECT *r)
{
	const uint8_t *px = bitmap;
	size_t w = (r->right - r->left + 1) * 3;

	for (int y = r->top; y <= r->bottom; y++, px += w) {
		memcpy(&decoded[(y * DEC_SIDE + r->left) * 3], px, w);
	}
	return 1;
}

/* Area (box-filter) resize DEC_SIDE -> S per channel, then uint8 -> int8 through the LUT, written as CHW.
 * At S = 84 DEC_SIDE is 84 too and this is a copy + LUT. */
static void to_input(void)
{
	if (DEC_SIDE == S) { /* 84: nothing to resize, LUT + HWC -> CHW only (same result as the loop below at k = 1) */
		for (int i = 0; i < S * S; i++) {
			for (int c = 0; c < 3; c++) {
				input_chw[c * S * S + i] = polyp_input_lut[decoded[i * 3 + c]];
			}
		}
		return;
	}
	const float k = (float)DEC_SIDE / S;

	for (int oy = 0; oy < S; oy++) {
		float y0 = oy * k, y1 = y0 + k;

		for (int ox = 0; ox < S; ox++) {
			float x0 = ox * k, x1 = x0 + k, acc[3] = {0}, area = 0;

			for (int iy = (int)y0; iy < (int)ceilf(y1); iy++) {
				float wy = MIN(y1, iy + 1) - MAX(y0, iy);

				for (int ix = (int)x0; ix < (int)ceilf(x1); ix++) {
					float wgt = wy * (MIN(x1, ix + 1) - MAX(x0, ix));
					const uint8_t *p = &decoded[(iy * DEC_SIDE + ix) * 3];

					acc[0] += wgt * p[0];
					acc[1] += wgt * p[1];
					acc[2] += wgt * p[2];
					area += wgt;
				}
			}
			for (int c = 0; c < 3; c++) {
				input_chw[c * S * S + oy * S + ox] = polyp_input_lut[(uint8_t)lroundf(acc[c] / area)];
			}
		}
	}
}

static int preprocess(size_t len)
{
	JDEC jd;
	struct src s = {jpeg, len};
	JRESULT rc = jd_prepare(&jd, jd_in, tjpgd_pool, sizeof(tjpgd_pool), &s);

	if (rc == JDR_OK) {
		if (jd.width != FRAME_SIDE || jd.height != FRAME_SIDE) {
			return -EINVAL;
		}
		rc = jd_decomp(&jd, jd_out, JPEG_SCALE);
	}
	if (rc != JDR_OK) {
		return -EIO;
	}
	to_input();
	return 0;
}

/* ------------------------------------------------------------------ box detector */

struct box { float x0, y0, x1, y1, conf; };

/* Raw one-to-one head -> best DET_MAX boxes, same as runner.decode_axon() on the PC. Per level: a 1-channel class
 * logit and a 4-channel box (left/top/right/bottom distance in cells from the cell centre), both CHW. */
static int decode_boxes(const nrf_axon_nn_compiled_model_s *m, struct box *best)
{
	const float floor_logit = logf(DET_CONF_FLOOR / (1 - DET_CONF_FLOOR));
	int nb = 0;

	for (int i = 0; i < m->output_cnt; i++) {
		const nrf_axon_compiled_model_output_s *c = &m->outputs[i], *b = NULL;
		int g = c->dimensions.height;

		if (c->dimensions.channel_cnt != 1) {
			continue;
		}
		for (int j = 0; j < m->output_cnt; j++) {
			if (m->outputs[j].dimensions.channel_cnt == 4 && m->outputs[j].dimensions.height == g) {
				b = &m->outputs[j];
			}
		}
		const float cs = ldexpf(c->dequant_mult, -c->dequant_round), bs = ldexpf(b->dequant_mult, -b->dequant_round);
		const float st = (float)DET_INPUT_SIZE / g;
		const int8_t *cq = det_out + c->packed_buffer_offset, *bq = det_out + b->packed_buffer_offset;

		for (int k = 0; k < g * g; k++) {
			float logit = (cq[k] - c->dequant_zp) * cs;

			if (logit < floor_logit) {
				continue;
			}
			float ax = k % g + 0.5f, ay = k / g + 0.5f, d[4];

			for (int ch = 0; ch < 4; ch++) {
				d[ch] = (bq[ch * g * g + k] - b->dequant_zp) * bs;
			}
			struct box nbx = {(ax - d[0]) * st, (ay - d[1]) * st, (ax + d[2]) * st, (ay + d[3]) * st,
					  1.0f / (1.0f + expf(-logit))};
			int at = nb < DET_MAX ? nb++ : DET_MAX;

			while (at > 0 && best[at - 1].conf < nbx.conf) { /* insertion sort, best first */
				if (at < DET_MAX) {
					best[at] = best[at - 1];
				}
				at--;
			}
			if (at < DET_MAX) {
				best[at] = nbx;
			}
		}
	}
	return nb;
}

static void run_det(uint32_t fid, uint64_t t_first, uint64_t t_rx, char *line, size_t size)
{
	struct box best[DET_MAX];

	for (int i = 0; i < DET_INPUT_SIZE * DET_INPUT_SIZE; i++) {
		for (int c = 0; c < 3; c++) {
			det_chw[c * DET_INPUT_SIZE * DET_INPUT_SIZE + i] = det_input_lut[jpeg[i * 3 + c]];
		}
	}
	uint64_t t0 = now_us();
	int err = nrf_axon_nn_model_infer_sync(&DET_MODEL, det_chw, det_out);
	uint64_t t1 = now_us();
	int nb = err ? 0 : decode_boxes(&DET_MODEL, best);
	uint64_t t2 = now_us();

	if (err) {
		LOG_ERR("frame %u: detector error %d", fid, err);
	}
	int n = snprintk(line, size, "D,%u,%llu,%llu,%llu,%llu,%llu,%llu,%d", fid, t_first, t_rx, t0, t1, t2, now_us(),
			 nb);

	for (int i = 0; i < nb; i++) {
		n += snprintk(line + n, size - n, ",%d,%d,%d,%d,%.3f", (int)lroundf(best[i].x0), (int)lroundf(best[i].y0),
			      (int)lroundf(best[i].x1), (int)lroundf(best[i].y1), (double)best[i].conf);
	}
	n += snprintk(line + n, size - n, "\n");
	write_all(line, n);
}

/* ------------------------------------------------------------------ main loop */

int main(void)
{
	char line[384];

	if (nrf_axon_platform_init() != 0 || nrf_axon_nn_model_validate(&MODEL) != 0 ||
	    nrf_axon_nn_model_validate(&DET_MODEL) != 0) {
		LOG_ERR("Axon init / model validate failed");
		return 0;
	}
	const nrf_axon_compiled_model_output_s *last = &DET_MODEL.outputs[DET_MODEL.output_cnt - 1];

	if (last->packed_buffer_offset + last->packed_size > sizeof(det_out)) {
		LOG_ERR("det_out too small: %u B needed", last->packed_buffer_offset + last->packed_size);
		return 0;
	}
	struct usbd_context *usbd = sample_usbd_init_device(NULL);

	if (!device_is_ready(cdc) || !usbd || usbd_enable(usbd)) {
		LOG_ERR("USB CDC-ACM not ready");
		return 0;
	}
	uart_irq_callback_set(cdc, uart_cb);
	uart_irq_rx_enable(cdc);
	LOG_INF("polyp classifier ready: %dx%d input, threshold %d", S, S, POLYP_THRESHOLD_INT8);

	while (1) {
		uint8_t hdr[12];

		read_exact(hdr, 4);
		bool is_raw = !memcmp(hdr, "RAW0", 4), is_fwd = !memcmp(hdr, "FWD0", 4);
		bool is_det = !memcmp(hdr, "DET0", 4), is_cmd = !memcmp(hdr, "CMD0", 4);

		if (!is_raw && !is_fwd && !is_det && !is_cmd && memcmp(hdr, "FRM0", 4)) {
			continue; /* resync */
		}
		read_exact(hdr + 4, 8);
		uint64_t t_first = now_us();
		k_thread_runtime_stats_t cpu0, cpu1;

		memset(&rxd, 0, sizeof(rxd));
		k_thread_runtime_stats_all_get(&cpu0);
		uint32_t fid = sys_get_le32(hdr + 4), len = sys_get_le32(hdr + 8);
		uint8_t *payload = is_raw ? decoded : jpeg;

		if (is_raw ? len != sizeof(decoded) : is_det ? len != DET_BYTES : is_cmd ? len > MAX_CMD : len > MAX_JPEG) {
			LOG_ERR("frame %u: bad length %u", fid, len);
			continue;
		}
		read_exact(payload, len);
		uint64_t t_rx = now_us();

		if (is_cmd) { /* the actuation point: a real device would start the injection here */
			write_all(line, snprintk(line, sizeof(line), "A,%u,%llu,%llu\n", fid, t_first, t_rx));
			continue;
		}
		if (is_det) {
			run_det(fid, t_first, t_rx, line, sizeof(line));
			continue;
		}

		k_thread_runtime_stats_all_get(&cpu1);
		/* CPU busy share while the payload came in (ISRs count towards the thread they interrupt) */
		uint32_t busy_pct = (uint32_t)(100 * (cpu1.total_cycles - cpu0.total_cycles) /
					       MAX(cpu1.execution_cycles - cpu0.execution_cycles, 1));

		int err = is_fwd ? 0 : is_raw ? (to_input(), 0) : preprocess(len);
		uint64_t t0 = now_us();
		int infer = err || is_fwd ? err : nrf_axon_nn_model_infer_sync(&MODEL, input_chw, output);
		uint64_t t1 = now_us();

		int raw = infer ? -128 : is_fwd ? 127 : output[0];
		int det = is_fwd || (!infer && raw >= POLYP_THRESHOLD_INT8);
		float score = 1.0f / (1.0f + expf(-(raw - POLYP_OUTPUT_ZERO_POINT) * POLYP_OUTPUT_SCALE));

		if (infer) {
			LOG_ERR("frame %u: preprocess/inference error %d", fid, infer);
		}
		uint64_t t_sent = now_us();
		int n = snprintk(line, sizeof(line), "R,%u,%llu,%llu,%llu,%llu,%llu,%d,%.4f,%d,%u,%u,%u,%u,%u\n", fid,
				 t_first, t_rx, t0, t1, t_sent, raw, (double)score, det, det ? len : 0, rxd.reads,
				 rxd.gap_max_us, rxd.pauses, busy_pct);

		write_all(line, n);
		if (det) {
			write_all(payload, len);
		}
	}
	return 0;
}
```

## src/axon_int8.h
```c
/* Generated by YOLO/export_axon.py. Input: RGB uint8 -> int8 through det_input_lut, CHW for Axon. */
#pragma once
#include <stdint.h>
#define DET_INPUT_SIZE 160
#define DET_LEVELS 3
static const uint8_t det_strides[DET_LEVELS] = {8, 16, 32};
static const int8_t det_input_lut[256] = {
	-128, -127, -126, -125, -124, -123, -122, -121, -120, -119, -118, -117, -116, -115, -114, -113,
	-112, -111, -110, -109, -108, -107, -106, -105, -104, -103, -102, -101, -100, -99, -98, -97,
	-96, -95, -94, -93, -92, -91, -90, -89, -88, -87, -86, -85, -84, -83, -82, -81,
	-80, -79, -78, -77, -76, -75, -74, -73, -72, -71, -70, -69, -68, -67, -66, -65,
	-64, -63, -62, -61, -60, -59, -58, -57, -56, -55, -54, -53, -52, -51, -50, -49,
	-48, -47, -46, -45, -44, -43, -42, -41, -40, -39, -38, -37, -36, -35, -34, -33,
	-32, -31, -30, -29, -28, -27, -26, -25, -24, -23, -22, -21, -20, -19, -18, -17,
	-16, -15, -14, -13, -12, -11, -10, -9, -8, -7, -6, -5, -4, -3, -2, -1,
	0, 1, 2, 3, 4, 5, 6, 7, 8, 9, 10, 11, 12, 13, 14, 15,
	16, 17, 18, 19, 20, 21, 22, 23, 24, 25, 26, 27, 28, 29, 30, 31,
	32, 33, 34, 35, 36, 37, 38, 39, 40, 41, 42, 43, 44, 45, 46, 47,
	48, 49, 50, 51, 52, 53, 54, 55, 56, 57, 58, 59, 60, 61, 62, 63,
	64, 65, 66, 67, 68, 69, 70, 71, 72, 73, 74, 75, 76, 77, 78, 79,
	80, 81, 82, 83, 84, 85, 86, 87, 88, 89, 90, 91, 92, 93, 94, 95,
	96, 97, 98, 99, 100, 101, 102, 103, 104, 105, 106, 107, 108, 109, 110, 111,
	112, 113, 114, 115, 116, 117, 118, 119, 120, 121, 122, 123, 124, 125, 126, 127
};
```
